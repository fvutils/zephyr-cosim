## src/zcosim/share/zephyr/arch/cosim/Kconfig
```kconfig
# General configuration options

# Copyright (c) 2017 Intel Corporation
# SPDX-License-Identifier: Apache-2.0

menu "Cosim (native) Options"
	depends on ARCH_COSIM

config ARCH
	default "cosim"

config ARCH_COSIM_RECOMMENDED_STACK_SIZE
	int
	default 40 if 64BIT
	default 24
	help
	  In bytes, stack size for Zephyr threads meant only for the Cosim
	  architecture.
	  (In this architecture only part of the thread status is kept in the Zephyr
	  thread stack, the real stack is the native underlying pthread stack.
	  Therefore the allocated stack can be limited to this size)

endmenu
```

## src/zcosim/share/zephyr/soc/cosim/simple/Kconfig.defconfig
```kconfig
# Copyright (c) 2017 Intel Corporation
# SPDX-License-Identifier: Apache-2.0

if SOC_COSIM_SIMPLE

config SOC
	default "simple"

config SYS_CLOCK_HW_CYCLES_PER_SEC
	default 1000000

config COSIM_HAS_CPU_IDLE
	bool

endif # SOC_COSIM_SIMPLE
```

## src/zcosim/share/zephyr/soc/cosim/simple/Kconfig.soc
```kconfig
# SPDX-License-Identifier: Apache-2.0

config SOC_COSIM_SIMPLE
	bool "Cosim Integration"
	select COSIM
	help
	  SOC for to the Cosim architecture. 
```

## ve/example/boards/cosim/test/Kconfig
```kconfig
# SPDX-License-Identifier: Apache-2.0

config BOARD_TEST
	bool
	select HAS_DTS

if BOARD_TEST

comment "Test Cosim options"


endif
```

## ve/example/boards/cosim/test/Kconfig.board
```kconfig
# SPDX-License-Identifier: Apache-2.0

#config BOARD_TEST_COSIM_32BIT
#	bool "Native POSIX for 32-bit host"
#	depends on SOC_COSIM
#	select BOARD_TEST_COSIM
#	help
#	  Will produce a console Linux process which can be executed natively
#	  as a 32-bit executable.
#	  It provides some minimal needed models:
#	  An interrupt controller, timer (system tick), and redirects kernel prints to
#	  stdout.
#
config BOARD_TEST
	bool "Native POSIX for 64-bit host"
	depends on SOC_COSIM_SIMPLE
        select COSIM
	help
	  Will produce a console Linux process which can be executed natively
	  as a 64-bit executable.
	  It provides some minimal needed models:
	  An interrupt controller, timer (system tick), and redirects kernel prints to
	  stdout.
```

## ve/example/boards/cosim/test/Kconfig.defconfig
```kconfig
# SPDX-License-Identifier: Apache-2.0

config BOARD
	default "test"
	depends on BOARD_TEST
```

## ve/example/boards/cosim/test/test_defconfig
```kconfig
# SPDX-License-Identifier: Apache-2.0

CONFIG_SOC_COSIM_SIMPLE=y
CONFIG_BOARD_TEST=y
```
